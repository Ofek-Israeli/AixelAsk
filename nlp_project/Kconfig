## nlp_project/Kconfig
```kconfig
mainmenu "AixelAsk Local Pipeline Configuration"

source "Kconfig.model"
source "Kconfig.server"
source "Kconfig.dataset"
source "Kconfig.split"
source "Kconfig.retrieval"
source "Kconfig.output"
source "Kconfig.runtime"
source "Kconfig.dagstats"
source "Kconfig.training"
source "Kconfig.training_stats"
source "Kconfig.test_trained"
```

## nlp_project/Kconfig.dagstats
```kconfig
menu "DAG Statistics"

config DAG_STATS_ENABLE
	bool "Enable DAG statistics collection"
	default y
	help
	  Master switch: collect DAG metrics during the run.

config DAG_STATS_FILE
	string "DAG stats output file"
	default "output/dag_stats.json"
	depends on DAG_STATS_ENABLE
	help
	  Path where the end-of-run summary is written (JSON). A CSV sidecar
	  is written to the same basename with .csv extension.

config DAG_STATS_INCLUDE_FAILED
	bool "Include failed items in stats"
	default y
	depends on DAG_STATS_ENABLE
	help
	  Include items where DAG generation failed (all retries exhausted /
	  fell back to no-plan) in the summary statistics.

config DAG_STATS_WRITE_PER_ITEM
	bool "Write per-item metrics"
	default n
	depends on DAG_STATS_ENABLE
	help
	  Stream per-item metrics to a JSONL sidecar
	  (<basename>_per_item.jsonl) as each item completes.

config LOG_EXECUTOR_STATS
	bool "Include executor telemetry"
	default y
	depends on DAG_STATS_ENABLE
	help
	  Include per-item executor telemetry (frontier widths, wave counts,
	  concurrency achieved) in dag_stats output.

config DAG_STATS_VALIDITY_ERRORS
	bool "Include validity error breakdown"
	default y
	depends on DAG_STATS_ENABLE
	help
	  Include the validity error breakdown (counts and fractions by
	  error category) in the end-of-run summary.

endmenu
```

## nlp_project/Kconfig.model
```kconfig
menu "Model Configuration"

config INFERENCE_MODEL
	string "Inference LLM (HF repo ID)"
	default "mistralai/Mistral-7B-Instruct-v0.3"
	help
	  HF repo ID for the inference LLM. At runtime,
	  download_models.resolve_model_path(config) resolves this +
	  INFERENCE_MODEL_REVISION to a local snapshot directory path,
	  and that local path is passed to SGLang --model-path,
	  lora_factory.build_model_and_tokenizer(), and any other consumer.

config INFERENCE_MODEL_REVISION
	string "Inference model HF revision"
	default "main"
	help
	  HF revision / commit SHA / tag. Used by snapshot_download to pin
	  a specific model version. After download, the resolved local
	  snapshot path is used everywhere.

config EMBEDDING_MODEL
	string "Embedding model name"
	default "nomic-ai/nomic-embed-text-v1"
	help
	  SentenceTransformer(...) model name for embeddings.

config MODEL_CACHE_DIR
	string "Hugging Face cache root directory"
	default "/workspace/.cache/huggingface"
	help
	  Set as HF_HOME and TRANSFORMERS_CACHE env vars at startup. All HF
	  libraries use $HF_HOME/hub/ as the model hub cache. Must be on
	  the persistent Volume disk so models survive Pod restarts.

config TRUST_REMOTE_CODE
	bool "Trust remote code for embedding model"
	default y
	help
	  Pass --trust-remote-code for nomic and other models that require
	  executing code from the HF Hub.

choice NOMIC_PREFIX_MODE
	prompt "Nomic embedding prefix mode"
	default NOMIC_PREFIX_AUTO
	help
	  How the embedding client prepends search_query: / search_document:
	  prefixes to input text before encoding.

config NOMIC_PREFIX_AUTO
	bool "AUTO — heuristic prefix selection"
	help
	  Inputs containing ?, starting with "question" (case-insensitive),
	  or shorter than 40 characters get search_query: prefix; everything
	  else gets search_document: prefix.

config NOMIC_PREFIX_ALWAYS_QUERY
	bool "ALWAYS_QUERY — always prepend search_query:"

config NOMIC_PREFIX_ALWAYS_DOCUMENT
	bool "ALWAYS_DOCUMENT — always prepend search_document:"

config NOMIC_PREFIX_NONE
	bool "NONE — no prefix"
	help
	  Useful for non-nomic models or testing.

endchoice

endmenu
```

## nlp_project/Kconfig.output
```kconfig
menu "Output / Logging Configuration"

config PERSISTENT_ROOT
	string "Persistent output root directory"
	default "/workspace/AixelAsk/nlp_project"
	help
	  Root for all persistent output/cache/checkpoint artifacts. Must be
	  on the Runpod Volume disk. All relative output/cache/checkpoint
	  paths are resolved relative to this.

config EPHEMERAL_TMPDIR
	string "Ephemeral temp directory"
	default "/tmp"
	help
	  Root for temporary/scratch files that need not survive Pod restarts
	  (TeX compile scratch, transient downloads).

config RESULT_FILE
	string "Result file path"
	default "output/results.jsonl"
	help
	  Where final results are written (resolved relative to
	  PERSISTENT_ROOT).

config EMBEDDING_CACHE
	string "Embedding cache path"
	default "cache/table_embeddings.jsonl"
	help
	  Precomputed embedding cache (persistent on Volume disk; resolved
	  relative to PERSISTENT_ROOT).

config LOG_FILE
	string "Log file path"
	default "output/run.log"
	help
	  Log file path (resolved relative to PERSISTENT_ROOT).

choice LOG_LEVEL
	prompt "Log level"
	default LOG_LEVEL_INFO
	help
	  Logging verbosity level.

config LOG_LEVEL_DEBUG
	bool "DEBUG"

config LOG_LEVEL_INFO
	bool "INFO"

config LOG_LEVEL_WARNING
	bool "WARNING"

config LOG_LEVEL_ERROR
	bool "ERROR"

endchoice

config LOG_LLM_PROMPTS
	bool "Log LLM prompts"
	default n
	select LOG_LLM_RESPONSES
	help
	  When enabled, store the exact prompt text sent to the LLM for each
	  call inside the results JSONL. Also logs prompts at DEBUG level.
	  Automatically enables LOG_LLM_RESPONSES.

config LOG_LLM_RESPONSES
	bool "Log LLM responses"
	default n
	help
	  When enabled, store the raw LLM response text in each call record.
	  Automatically enabled when LOG_LLM_PROMPTS=y; can also be enabled
	  independently.

config LOG_LLM_CALLS_MAX_CHARS
	int "Max chars per LLM prompt/response field"
	default 200000
	help
	  Maximum character length for any single prompt or response_text
	  field in the JSONL. Strings exceeding this are truncated. Set to
	  0 for unlimited.

config LOG_LLM_CALLS_PER_ITEM
	bool "Embed llm_calls in per-item results"
	default n
	help
	  When enabled, embed the llm_calls array inside each per-item
	  result record in RESULT_FILE. A CallRecorder is created if any
	  call-capture artifact is enabled.

config LLM_CALLS_SIDEFILE
	string "LLM calls sidefile path"
	default ""
	help
	  If non-empty, write a separate JSONL file with one record per LLM
	  call (flat, not nested). Each record includes item index and
	  question for join-ability.

endmenu
```

## nlp_project/Kconfig.retrieval
```kconfig
menu "Retrieval / DAG Configuration"

config USE_DAG
	bool "Use DAG-based plan (vs linear plan)"
	default y
	help
	  Enable DAG-based retrieval plan generation. When disabled, a
	  linear plan is used instead.

config DAG_MAX_RETRIES
	int "DAG generation max retries"
	default 10
	help
	  max_attempts in generate_dag.py — how many times to retry DAG
	  generation on parse/validation failure.

choice DAG_PROMPT_VARIANT
	prompt "DAG prompt template variant"
	default DAG_PROMPT_STANDARD
	help
	  Selects which shipped DAG prompt template to use. Overridden if
	  PLAN_PROMPT is set to a non-empty string.

config DAG_PROMPT_STANDARD
	bool "Standard — LLM freely chooses DAG structure"
	help
	  Uses prompt/get_dag.md. The LLM freely chooses DAG structure
	  (parallel, sequential, or hybrid).

config DAG_PROMPT_MIN_DEPTH_BASELINE
	bool "Min-depth baseline — encourages shallow, parallel DAGs"
	help
	  Uses prompt/get_dag_min_depth.md. Identical to standard except
	  for one added instruction line encouraging minimal-depth,
	  maximally-parallel DAGs.

endchoice

config PLAN_PROMPT
	string "Manual DAG prompt template path override"
	default ""
	help
	  If non-empty, overrides DAG_PROMPT_VARIANT and uses this path
	  verbatim as the prompt template. If empty (default), the path is
	  resolved from DAG_PROMPT_VARIANT.

choice FEWSHOT_VARIANT
	prompt "Few-shot example set"
	default FEWSHOT_STANDARD_ALL3
	help
	  Selects which set of few-shot files populates {{ fewshot }} at
	  runtime. Independent of DAG prompt variant — the two knobs are
	  orthogonal.

config FEWSHOT_STANDARD_ALL3
	bool "Standard — all 3 types (parallel + sequential + hybrid)"
	help
	  Concatenates fewshot_parallel.txt, fewshot_sequential.txt,
	  fewshot_hybrid.txt. 6 examples total.

config FEWSHOT_PARALLEL_HYBRID_EXTENDED
	bool "Parallel + hybrid extended (no sequential)"
	help
	  Concatenates fewshot_parallel.txt, fewshot_hybrid.txt,
	  fewshots_extended.txt.

endchoice

config FINAL_REASONING_PROMPT
	string "Final reasoning prompt template"
	default "prompt/final_reasoning_DAG.md"
	help
	  Path to the final reasoning prompt template.

config NOPLAN_REASONING_PROMPT
	string "No-plan fallback reasoning prompt"
	default "prompt/noplan_reasoning.md"
	help
	  Fallback reasoning prompt used when DAG generation fails.

config ROW_PROMPT
	string "Row template prompt"
	default "prompt/get_row_template.md"
	help
	  Prompt template for row retrieval.

config COL_PROMPT
	string "Column template prompt"
	default "prompt/get_col_template.md"
	help
	  Prompt template for column retrieval.

config SCHEMA_LINKING_PROMPT
	string "Schema linking prompt"
	default "prompt/prompt_schema_linking.md"
	help
	  Prompt template for schema linking.

config NUM_SAMPLE_ROWS
	int "Number of sample rows"
	default 5
	help
	  num_samples passed to sample_table_rows for table previews.

endmenu
```

## nlp_project/Kconfig.runtime
```kconfig
menu "Runtime Configuration"

config MAX_WORKERS
	int "Thread pool max workers"
	default 5
	help
	  ThreadPoolExecutor(max_workers=...) for concurrent item processing.

config LLM_MAX_OUTPUT_TOKENS
	int "LLM max output tokens"
	default 2048
	help
	  max_tokens in chat completion calls. Controls completion length,
	  not context window (context is SGLANG_CONTEXT_LENGTH).

config LLM_RETRIES
	int "LLM call retry count"
	default 30
	help
	  Number of retries for LLM calls on failure.

comment "LLM Sampling Parameters"

config LLM_TEMPERATURE
	string "Sampling temperature"
	default "0.0"
	help
	  Controls randomness. 0.0 = greedy/deterministic. Parsed as float.

config LLM_TOP_P
	string "Nucleus sampling (top_p)"
	default "1.0"
	help
	  Nucleus sampling threshold. 1.0 = no nucleus filtering. Parsed
	  as float.

config LLM_TOP_K
	int "Top-k sampling"
	default 0
	help
	  0 = disabled (field omitted from request). SGLang-specific;
	  ignored by standard OpenAI API.

config LLM_FREQUENCY_PENALTY
	string "Frequency penalty"
	default "0.0"
	help
	  Penalizes tokens by their frequency in the response so far.
	  Range [-2.0, 2.0]. Parsed as float.

config LLM_PRESENCE_PENALTY
	string "Presence penalty"
	default "0.0"
	help
	  Penalizes tokens that have appeared at all. Range [-2.0, 2.0].
	  Parsed as float.

config LLM_SEED
	int "LLM sampling seed"
	default -1
	help
	  -1 = omit the field (server chooses). >=0 = include seed=<value>
	  in the request for reproducible sampling (best-effort).

comment "Embedding Parameters"

config EMBEDDING_BATCH_SIZE
	int "Embedding encode batch size"
	default 32
	help
	  Batch size for SentenceTransformer.encode().

config EMBEDDING_DEVICE
	string "Embedding model device"
	default "cuda"
	help
	  "cuda" or "cpu" for the embedding model.

config EMBEDDING_RETRIES
	int "Embedding call retries"
	default 5
	help
	  Retry count for embedding calls.

comment "Execution Parameters"

config SKIP_EXISTING
	bool "Skip already-processed indices"
	default y
	help
	  Skip indices that already exist in the result file.

config CUDA_VISIBLE_DEVICES
	string "CUDA_VISIBLE_DEVICES override"
	default ""
	help
	  If non-empty, set as CUDA_VISIBLE_DEVICES env var before launching
	  SGLang and loading the embedding model. Empty = inherit from
	  environment. Example: "0" for single-GPU, "0,1" for 2-GPU TP.

comment "Concurrency Limits"

config DAG_NODE_MAX_INFLIGHT
	int "Max in-flight DAG nodes per item"
	default 16
	help
	  Maximum DAG nodes executing concurrently within a single item's
	  DAG. Limits frontier width.

config RETRIEVAL_PARALLELISM
	int "Retrieval parallelism per frontier"
	default 8
	help
	  Maximum concurrent retrieval operations within a single DAG
	  frontier (embedding + similarity search).

config RETRIEVAL_EMBED_BATCH_SIZE
	int "Retrieval embedding batch size"
	default 32
	help
	  Batch size for embed_batch() when coalescing multiple retrieval
	  nodes in the same frontier.

config REASONING_PARALLELISM
	int "Reasoning parallelism per frontier"
	default 8
	help
	  Maximum concurrent LLM (reasoning) calls within a single DAG
	  frontier.

config SGLANG_CLIENT_CONCURRENCY
	int "SGLang client concurrency (global)"
	default 32
	help
	  Global cap on outstanding HTTP requests to the SGLang server
	  across all items/threads. Implemented as a shared semaphore.

config GLOBAL_EMBEDDING_CONCURRENCY
	int "Global embedding concurrency"
	default 4
	help
	  Global cap on concurrent embed_batch calls across all items.
	  Serializes GPU embedding access to prevent OOM.

endmenu
```

## nlp_project/Kconfig.server
```kconfig
menu "Inference Backend Configuration"

choice
	prompt "Inference backend"
	default BACKEND_SGLANG

config BACKEND_SGLANG
	bool "SGLang"
	help
	  Use SGLang as the inference server (OpenAI-compatible API).

config BACKEND_VLLM
	bool "vLLM"
	help
	  Use vLLM as the inference server (OpenAI-compatible API).

endchoice

comment "Common server settings"

config SERVER_HOST
	string "Server bind host"
	default "0.0.0.0"
	help
	  --host argument for the inference server.

config SERVER_PORT
	int "Server port"
	default 30000
	help
	  --port argument for the inference server.

config SERVER_TP_SIZE
	int "Tensor parallelism size"
	default 1
	help
	  Number of GPUs for tensor-parallel inference.

config SERVER_DTYPE
	string "Model dtype"
	default "float16"
	help
	  Model dtype (e.g. float16, bfloat16, auto).

config SERVER_CONTEXT_LENGTH
	int "Context length"
	default 8192
	help
	  Maximum context length. Mistral-7B-v0.3 supports up to 32768.

config SERVER_HEALTH_TIMEOUT
	int "Health check timeout (seconds)"
	default 300
	help
	  Seconds to wait for the server health probe to return 200.

config SERVER_HEALTH_INTERVAL
	int "Health check poll interval (seconds)"
	default 5
	help
	  Seconds between health check polls.

config SERVER_HEALTH_ENDPOINT
	string "Health check endpoint"
	default "/health"
	help
	  Primary health-check endpoint path.

comment "SGLang-specific settings"
	depends on BACKEND_SGLANG

config SGLANG_MEM_FRACTION
	string "KV-cache memory fraction (SGLang)"
	default "0.85"
	depends on BACKEND_SGLANG
	help
	  --mem-fraction-static for SGLang. Fraction of GPU memory allocated
	  to the KV cache.

config SGLANG_EXTRA_ARGS
	string "Extra SGLang arguments"
	default ""
	depends on BACKEND_SGLANG
	help
	  Appended verbatim to the SGLang launch command.

comment "vLLM-specific settings"
	depends on BACKEND_VLLM

config VLLM_GPU_MEMORY_UTILIZATION
	string "GPU memory utilization (vLLM)"
	default "0.85"
	depends on BACKEND_VLLM
	help
	  --gpu-memory-utilization for vLLM. Fraction of GPU memory for
	  KV cache and model weights.

config VLLM_EXTRA_ARGS
	string "Extra vLLM arguments"
	default ""
	depends on BACKEND_VLLM
	help
	  Appended verbatim to the vLLM launch command.

endmenu
```
